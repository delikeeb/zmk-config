## config/boards/shields/naan/Kconfig.defconfig
```kconfig
# Copyright (c) 2020 dELLIKEEb
# SPDX-License-Identifier: MIT

if SHIELD_NAAN_REV2

config ZMK_KEYBOARD_NAME
	default "NaaN rev2"

endif

config SSD1306
	default y

config SSD1306_REVERSE_MODE
	default y
```

## config/shields/naan/Kconfig.shield
```kconfig
# Copyright (c) 2020 dELLIKEEb
# SPDX-License-Identifier: MIT

config SHIELD_NAAN_REV2
	def_bool $(shields_list_contains,naan_rev2)
```
